## boards/shields/kin36_sweep36key/Kconfig.defconfig
```kconfig
# Copyright (c) 2020 The ZMK Contributors
# SPDX-License-Identifier: MIT

if SHIELD_KIN36_SWEEP36KEY_LEFT

config ZMK_KEYBOARD_NAME
    default "Kin36 Sweep36"

config ZMK_SPLIT_ROLE_CENTRAL
    default y

endif

if SHIELD_KIN36_SWEEP36KEY_LEFT || SHIELD_KIN36_SWEEP36KEY_RIGHT

config ZMK_SPLIT
    default y

endif
```

## boards/shields/kin36_sweep36key/Kconfig.shield
```kconfig
# Copyright (c) 2020 The ZMK Contributors
# SPDX-License-Identifier: MIT

config SHIELD_KIN36_SWEEP36KEY_LEFT
    def_bool $(shields_list_contains,kin36_sweep36key_left)

config SHIELD_KIN36_SWEEP36KEY_RIGHT
    def_bool $(shields_list_contains,kin36_sweep36key_right)
```
